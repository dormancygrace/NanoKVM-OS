## firmware/boot/fit/boot.its
```
/dts-v1/;
/ {
    description = "NanoKVM Enhanced candidate - hardware qualification pending";
    #address-cells = <1>;
    images {
        kernel-1 {
            description = "NanoKVM Enhanced Linux";
            data = /incbin/("Image.gz");
            type = "kernel";
            arch = "riscv";
            os = "linux";
            compression = "gzip";
            load = <0x80200000>;
            entry = <0x80200000>;
            hash-1 { algo = "sha256"; };
        };
        ramdisk-1 {
            description = "Adapted stock init with current Buildroot userspace";
            data = /incbin/("initramfs.cpio.gz");
            type = "ramdisk";
            arch = "riscv";
            os = "linux";
            // Linux unpacks gzip cpio; U-Boot passes these bytes unchanged.
            compression = "none";
            hash-1 { algo = "sha256"; };
        };
        fdt-sg2002_licheervnano_sd_minimal {
            description = "NanoKVM Enhanced SG2002 board";
            data = /incbin/("board.dtb");
            type = "flat_dt";
            arch = "riscv";
            compression = "none";
            hash-1 { algo = "sha256"; };
        };
    };
    configurations {
        default = "config-sg2002_licheervnano_sd_minimal";
        config-sg2002_licheervnano_sd_minimal {
            description = "NanoKVM Enhanced with installed loader selection";
            kernel = "kernel-1";
            ramdisk = "ramdisk-1";
            fdt = "fdt-sg2002_licheervnano_sd_minimal";
        };
    };
};
```

## firmware/buildroot/configs/nanokvm_enhanced_defconfig
```kconfig
BR2_riscv=y
BR2_riscv_g=y
BR2_RISCV_64=y
BR2_RISCV_ISA_RVC=y
BR2_TOOLCHAIN_BUILDROOT_MUSL=y
BR2_KERNEL_HEADERS_VERSION=y
BR2_DEFAULT_KERNEL_VERSION="7.2.5"
BR2_PACKAGE_HOST_LINUX_HEADERS_CUSTOM_7_1=y
BR2_GCC_VERSION_16_X=y
BR2_TOOLCHAIN_BUILDROOT_CXX=y
BR2_GCC_ENABLE_OPENMP=y
BR2_OPTIMIZE_2=y
BR2_REPRODUCIBLE=y
BR2_CCACHE=y
BR2_TARGET_GENERIC_HOSTNAME="nanokvm"
BR2_TARGET_GENERIC_ISSUE="NanoKVM OS v1.0.0 beta-8"
BR2_INIT_SYSV=y
BR2_ROOTFS_DEVICE_CREATION_DYNAMIC_EUDEV=y
# BR2_PACKAGE_EUDEV_ENABLE_HWDB is not set
BR2_ROOTFS_MERGED_USR=y
BR2_TARGET_ENABLE_ROOT_LOGIN=y
# Fixed hash of the existing factory password; users must change it at setup.
BR2_TARGET_GENERIC_ROOT_PASSWD="$$6$$nanokvm-beta$$ym.ddCYHf9BdddPSRTcBKB5i9btFYgt49KR70LwrAlUjqAx1.fFo1e74bhw3so6S0CYeYIff7p8GqgFrDupE3/"
BR2_TARGET_GENERIC_GETTY_PORT="console"
BR2_PACKAGE_BUSYBOX_CONFIG_FRAGMENT_FILES="$(BR2_EXTERNAL_NANOKVM_PATH)/board/busybox.config $(BR2_EXTERNAL_NANOKVM_PATH)/board/busybox-enhanced.config"
BR2_PACKAGE_E2FSPROGS=y
BR2_PACKAGE_E2FSPROGS_RESIZE2FS=y
BR2_PACKAGE_F2FS_TOOLS=y
BR2_PACKAGE_EXFATPROGS=y
BR2_PACKAGE_PARTED=y
BR2_PACKAGE_AVAHI=y
BR2_PACKAGE_AVAHI_DAEMON=y
BR2_PACKAGE_BASH=y
BR2_PACKAGE_CA_CERTIFICATES=y
BR2_PACKAGE_LIBCURL=y
BR2_PACKAGE_LIBCURL_CURL=y
BR2_PACKAGE_OPENSSL=y
# OpenVPN 3 and the wireless stack use libnl.
BR2_PACKAGE_LIBNL=y
BR2_PACKAGE_LIBOPENSSL_BIN=y
BR2_PACKAGE_LIBOPENSSL_ENGINES=y
BR2_PACKAGE_LIBOPENSSL_DYNAMIC_ENGINE=y
BR2_PACKAGE_HOSTAPD=y
BR2_PACKAGE_HOSTAPD_WPA3=y
BR2_PACKAGE_IPROUTE2=y
# BR2_PACKAGE_IPTABLES is not set
BR2_PACKAGE_IPTABLES_NFTABLES=y
BR2_PACKAGE_IPTABLES_NFTABLES_DEFAULT=y
BR2_PACKAGE_NFTABLES=y
BR2_PACKAGE_IPUTILS=y
BR2_PACKAGE_IW=y
BR2_PACKAGE_CHRONY=y
BR2_PACKAGE_OPENSSH=y
BR2_PACKAGE_OPENSSH_CLIENT=y
BR2_PACKAGE_OPENSSH_SERVER=y
BR2_PACKAGE_OPENSSH_KEY_UTILS=y
BR2_PACKAGE_WIRELESS_REGDB=y
BR2_PACKAGE_WPA_SUPPLICANT=y
BR2_PACKAGE_WPA_SUPPLICANT_WEXT=y
BR2_PACKAGE_WPA_SUPPLICANT_AP_SUPPORT=y
BR2_PACKAGE_WPA_SUPPLICANT_AUTOSCAN=y
BR2_PACKAGE_WPA_SUPPLICANT_HOTSPOT=y
BR2_PACKAGE_WPA_SUPPLICANT_WPA3=y
BR2_PACKAGE_WPA_SUPPLICANT_CLI=y
BR2_PACKAGE_WPA_SUPPLICANT_PASSPHRASE=y
BR2_PACKAGE_UTIL_LINUX_RFKILL=y
BR2_PACKAGE_PICOCOM=y
BR2_PACKAGE_STRACE=y
BR2_PACKAGE_TMUX=y
BR2_PACKAGE_RSYNC=y
BR2_PACKAGE_SOCAT=y
BR2_TARGET_ROOTFS_TAR=y
BR2_TARGET_ROOTFS_EXT2=y
BR2_TARGET_ROOTFS_EXT2_4=y
BR2_TARGET_ROOTFS_EXT2_SIZE="768M"
BR2_TARGET_ROOTFS_F2FS=y
BR2_TARGET_ROOTFS_F2FS_SIZE="768M"
# BR2_TARGET_ROOTFS_F2FS_DISCARD is not set
# Stable filesystem identity and directory hash seed for image reproduction.
BR2_TARGET_ROOTFS_EXT2_MKFS_OPTIONS="-O ^64bit -U 3fc20e1e-d1ff-5d50-ace2-ce36b50beefe -E hash_seed=ade93120-ef25-5b31-af06-85f9c5a00cfc"
BR2_PRIMARY_SITE="https://sources.buildroot.net"
BR2_WGET="wget --passive-ftp -nd -t 2 --timeout=20"
BR2_ROOTFS_OVERLAY="$(BR2_EXTERNAL_NANOKVM_PATH)/board/overlay"
BR2_PACKAGE_AIC8800_SDIO_FIRMWARE=y
BR2_PACKAGE_SG2002_CODEC_FIRMWARE=y
BR2_ROOTFS_POST_BUILD_SCRIPT="$(BR2_EXTERNAL_NANOKVM_PATH)/board/post-build.sh"
BR2_PACKAGE_DNSMASQ=y
BR2_TARGET_OPTIMIZATION="-march=rv64gc_xtheadba_xtheadbb_xtheadbs_xtheadcmo_xtheadcondmov_xtheadfmemidx_xtheadfmv_xtheadint_xtheadmac_xtheadmemidx_xtheadmempair_xtheadsync_xtheadvector -mtune=thead-c906 -mno-fence-tso"
BR2_ROOTFS_POST_SCRIPT_ARGS="enhanced"

BR2_PACKAGE_JSON_C=y

BR2_PACKAGE_NANOKVM_BOARD_TOOLS=y
BR2_PACKAGE_NKOS_APK_TOOLS=y
BR2_PACKAGE_NKOS_ADDONS=y

BR2_GLOBAL_PATCH_DIR="$(BR2_EXTERNAL_NANOKVM_PATH)/patches"

BR2_PACKAGE_WIREGUARD_TOOLS=y
BR2_PACKAGE_OPENRESOLV=y


BR2_PACKAGE_OPENVPN3=y

# Full IANA time zone database for Date & Time settings.
BR2_TARGET_TZ_INFO=y
BR2_TARGET_TZ_ZONELIST="default"
BR2_TARGET_LOCALTIME="Etc/UTC"
BR2_PACKAGE_NCURSES_WCHAR=y
BR2_PACKAGE_FILE=y

BR2_BINUTILS_VERSION_2_47_X=y
BR2_PACKAGE_HOST_UBOOT_TOOLS=y
BR2_PACKAGE_HOST_UBOOT_TOOLS_FIT_SUPPORT=y
BR2_PACKAGE_HOST_DTC=y

# Optional utilities are APK packages, not part of the base image.
# BR2_PACKAGE_OPENVPN is not set
# BR2_PACKAGE_WIRELESS_TOOLS is not set
# BR2_PACKAGE_MC is not set
# BR2_PACKAGE_NKOS_SUPERFILE is not set
# BR2_PACKAGE_NANO is not set
# BR2_PACKAGE_HTOP is not set
# BR2_PACKAGE_TCPDUMP is not set
# BR2_PACKAGE_ETHTOOL is not set
# BR2_PACKAGE_BLUEZ5_UTILS is not set
```

## firmware/buildroot/configs/nanokvm_optional_tools_defconfig
```kconfig
BR2_riscv=y
BR2_riscv_g=y
BR2_RISCV_64=y
BR2_RISCV_ISA_RVC=y
BR2_TOOLCHAIN_BUILDROOT_MUSL=y
BR2_KERNEL_HEADERS_VERSION=y
BR2_DEFAULT_KERNEL_VERSION="7.2.5"
BR2_PACKAGE_HOST_LINUX_HEADERS_CUSTOM_7_1=y
BR2_GCC_VERSION_16_X=y
BR2_TOOLCHAIN_BUILDROOT_CXX=y
BR2_OPTIMIZE_2=y
BR2_REPRODUCIBLE=y
BR2_CCACHE=y
BR2_TARGET_OPTIMIZATION="-march=rv64gc_xtheadba_xtheadbb_xtheadbs_xtheadcmo_xtheadcondmov_xtheadfmemidx_xtheadfmv_xtheadint_xtheadmac_xtheadmemidx_xtheadmempair_xtheadsync_xtheadvector -mtune=thead-c906 -mno-fence-tso"
BR2_GLOBAL_PATCH_DIR="$(BR2_EXTERNAL_NANOKVM_PATH)/patches"
BR2_BINUTILS_VERSION_2_47_X=y
# Separate source build for optional APK payload export, no board/application stage.
BR2_PACKAGE_MC=y
BR2_PACKAGE_NKOS_SUPERFILE=y
BR2_PACKAGE_NANO=y
# BR2_PACKAGE_NANO_TINY is not set
BR2_PACKAGE_NCURSES_WCHAR=y
BR2_PACKAGE_HTOP=y
BR2_PACKAGE_TCPDUMP=y
BR2_PACKAGE_ETHTOOL=y
BR2_PACKAGE_BLUEZ5_UTILS=y
BR2_PACKAGE_BLUEZ5_UTILS_CLIENT=y
BR2_PACKAGE_BLUEZ5_UTILS_MONITOR=y
BR2_PACKAGE_BLUEZ5_UTILS_TOOLS=y
BR2_PACKAGE_BLUEZ5_UTILS_PLUGINS_HID=y
BR2_PACKAGE_NANOKVM_OPTIONAL_TOOLS_LAYOUT=y
# BR2_TARGET_ROOTFS_TAR is not set
```

## firmware/buildroot/configs/nanokvm_sg2002_defconfig
```kconfig
BR2_riscv=y
BR2_riscv_g=y
BR2_RISCV_64=y
BR2_RISCV_ISA_RVC=y
BR2_TOOLCHAIN_BUILDROOT_MUSL=y
BR2_KERNEL_HEADERS_5_10=y
BR2_GCC_VERSION_15_X=y
BR2_TOOLCHAIN_BUILDROOT_CXX=y
BR2_GCC_ENABLE_OPENMP=y
BR2_OPTIMIZE_S=y
BR2_REPRODUCIBLE=y
BR2_CCACHE=y
BR2_TARGET_GENERIC_HOSTNAME="nanokvm"
BR2_TARGET_GENERIC_ISSUE="NanoKVM / Buildroot 2026.08"
BR2_INIT_SYSV=y
BR2_ROOTFS_DEVICE_CREATION_DYNAMIC_EUDEV=y
# BR2_PACKAGE_EUDEV_ENABLE_HWDB is not set
BR2_ROOTFS_MERGED_USR=y
BR2_TARGET_ENABLE_ROOT_LOGIN=y
BR2_TARGET_GENERIC_ROOT_PASSWD="root"
BR2_TARGET_GENERIC_GETTY_PORT="console"
BR2_PACKAGE_BUSYBOX_CONFIG_FRAGMENT_FILES="$(BR2_EXTERNAL_NANOKVM_PATH)/board/busybox.config"
BR2_PACKAGE_E2FSPROGS=y
BR2_PACKAGE_E2FSPROGS_RESIZE2FS=y
BR2_PACKAGE_EXFATPROGS=y
BR2_PACKAGE_PARTED=y
BR2_PACKAGE_AVAHI=y
BR2_PACKAGE_AVAHI_DAEMON=y
BR2_PACKAGE_BASH=y
BR2_PACKAGE_CA_CERTIFICATES=y
BR2_PACKAGE_LIBCURL=y
BR2_PACKAGE_LIBCURL_CURL=y
BR2_PACKAGE_OPENSSL=y
BR2_PACKAGE_LIBOPENSSL_BIN=y
BR2_PACKAGE_LIBOPENSSL_ENGINES=y
BR2_PACKAGE_LIBOPENSSL_DYNAMIC_ENGINE=y
BR2_PACKAGE_ETHTOOL=y
BR2_PACKAGE_HOSTAPD=y
BR2_PACKAGE_HOSTAPD_WPA3=y
BR2_PACKAGE_IPROUTE2=y
BR2_PACKAGE_IPTABLES=y
BR2_PACKAGE_IPUTILS=y
BR2_PACKAGE_IW=y
BR2_PACKAGE_CHRONY=y
BR2_PACKAGE_OPENSSH=y
BR2_PACKAGE_OPENSSH_CLIENT=y
BR2_PACKAGE_OPENSSH_SERVER=y
BR2_PACKAGE_OPENSSH_KEY_UTILS=y
BR2_PACKAGE_WIRELESS_REGDB=y
BR2_PACKAGE_WIRELESS_TOOLS=y
BR2_PACKAGE_WIRELESS_TOOLS_LIB=y
BR2_PACKAGE_WPA_SUPPLICANT=y
BR2_PACKAGE_WPA_SUPPLICANT_WEXT=y
BR2_PACKAGE_WPA_SUPPLICANT_AP_SUPPORT=y
BR2_PACKAGE_WPA_SUPPLICANT_AUTOSCAN=y
BR2_PACKAGE_WPA_SUPPLICANT_HOTSPOT=y
BR2_PACKAGE_WPA_SUPPLICANT_WPA3=y
BR2_PACKAGE_WPA_SUPPLICANT_CLI=y
BR2_PACKAGE_WPA_SUPPLICANT_PASSPHRASE=y
BR2_PACKAGE_UTIL_LINUX_RFKILL=y
BR2_PACKAGE_PICOCOM=y
BR2_PACKAGE_STRACE=y
BR2_PACKAGE_TCPDUMP=y
BR2_PACKAGE_HTOP=y
BR2_PACKAGE_NANO=y
BR2_PACKAGE_TMUX=y
BR2_PACKAGE_RSYNC=y
BR2_PACKAGE_SOCAT=y
BR2_TARGET_ROOTFS_TAR=y
BR2_TARGET_ROOTFS_EXT2=y
BR2_TARGET_ROOTFS_EXT2_4=y
BR2_TARGET_ROOTFS_EXT2_SIZE="1536M"
BR2_PRIMARY_SITE="https://sources.buildroot.net"
BR2_WGET="wget --passive-ftp -nd -t 2 --timeout=20"
BR2_ROOTFS_OVERLAY="$(BR2_EXTERNAL_NANOKVM_PATH)/board/overlay"
BR2_PACKAGE_NANOKVM_VENDOR_LIBC=y
BR2_PACKAGE_AIC8800_SDIO_FIRMWARE=y
BR2_PACKAGE_SG2002_CODEC_FIRMWARE=y
BR2_ROOTFS_POST_BUILD_SCRIPT="$(BR2_EXTERNAL_NANOKVM_PATH)/board/post-build.sh"
BR2_PACKAGE_DNSMASQ=y

# Full IANA time zone database for Date & Time settings.
BR2_TARGET_TZ_INFO=y
BR2_TARGET_TZ_ZONELIST="default"
BR2_TARGET_LOCALTIME="Etc/UTC"
# BR2_PACKAGE_NANO_TINY is not set
BR2_PACKAGE_NCURSES_WCHAR=y
BR2_PACKAGE_FILE=y
BR2_PACKAGE_MC=y
BR2_PACKAGE_NKOS_SUPERFILE=y
```

## firmware/kernel/nanokvm_enhanced_defconfig
```kconfig
CONFIG_LOCALVERSION="-nanokvm-enhanced"
# CONFIG_LOCALVERSION_AUTO is not set
CONFIG_SYSVIPC=y
CONFIG_POSIX_MQUEUE=y
CONFIG_AUDIT=y
CONFIG_NO_HZ_IDLE=y
CONFIG_HIGH_RES_TIMERS=y
CONFIG_BPF_SYSCALL=y
CONFIG_IKCONFIG=y
CONFIG_IKCONFIG_PROC=y
CONFIG_CGROUPS=y
CONFIG_MEMCG=y
CONFIG_BLK_CGROUP=y
CONFIG_CGROUP_SCHED=y
CONFIG_CFS_BANDWIDTH=y
CONFIG_CGROUP_PIDS=y
CONFIG_CGROUP_FREEZER=y
CONFIG_CGROUP_DEVICE=y
CONFIG_CGROUP_CPUACCT=y
CONFIG_CGROUP_PERF=y
CONFIG_CGROUP_BPF=y
CONFIG_USER_NS=y
CONFIG_BLK_DEV_INITRD=y
CONFIG_PERF_EVENTS=y
CONFIG_ARCH_SOPHGO=y
CONFIG_ARCH_THEAD=y
CONFIG_CPU_IDLE=y
CONFIG_RISCV_SBI_V01=y
CONFIG_RISCV_SBI_CPUIDLE=y
CONFIG_CPU_FREQ=y
CONFIG_CPU_FREQ_STAT=y
CONFIG_CPU_FREQ_GOV_POWERSAVE=m
CONFIG_CPU_FREQ_GOV_USERSPACE=y
CONFIG_CPU_FREQ_GOV_ONDEMAND=y
CONFIG_CPU_FREQ_GOV_CONSERVATIVE=m
CONFIG_CPUFREQ_DT=y
CONFIG_JUMP_LABEL=y
CONFIG_MODULES=y
CONFIG_MODULE_UNLOAD=y
CONFIG_BLK_DEV_THROTTLING=y
# Fixed 256 MiB, one hart: avoid the 16 MiB sparse section root table.
CONFIG_FLATMEM_MANUAL=y
CONFIG_NET=y
CONFIG_PACKET=y
CONFIG_UNIX=y
CONFIG_XFRM_USER=m
CONFIG_INET=y
CONFIG_IP_MULTICAST=y
CONFIG_IP_ADVANCED_ROUTER=y
CONFIG_INET_ESP=m
CONFIG_NETWORK_SECMARK=y
CONFIG_NETFILTER=y
CONFIG_NF_TABLES=m
CONFIG_NF_TABLES_INET=y
CONFIG_NFT_CT=m
CONFIG_NFT_COMPAT=m
CONFIG_NFT_LIMIT=m
CONFIG_NFT_LOG=m
CONFIG_NFT_REJECT_INET=m
CONFIG_NFT_FIB_INET=m
CONFIG_NFT_NAT=m
CONFIG_NFT_MASQ=m
CONFIG_NFT_REDIR=m
CONFIG_NF_NAT=m
CONFIG_NETFILTER_XT_MATCH_STATE=m
CONFIG_BRIDGE_NETFILTER=m
CONFIG_NF_CONNTRACK=m
CONFIG_NF_CONNTRACK_FTP=m
CONFIG_NF_CONNTRACK_TFTP=m
CONFIG_NETFILTER_XT_MARK=m
CONFIG_NETFILTER_XT_MATCH_ADDRTYPE=m
CONFIG_NETFILTER_XT_MATCH_CONNTRACK=m
CONFIG_NF_LOG_ARP=m
CONFIG_NF_LOG_IPV4=m
CONFIG_IP_NF_IPTABLES=m
CONFIG_NF_LOG_IPV6=m
CONFIG_IP6_NF_IPTABLES=m
CONFIG_IP6_NF_MATCH_IPV6HEADER=m
CONFIG_BRIDGE=m
CONFIG_BRIDGE_VLAN_FILTERING=y
CONFIG_VLAN_8021Q=m
CONFIG_NET_SCHED=y
CONFIG_NET_CLS_CGROUP=m
CONFIG_DNS_RESOLVER=y
CONFIG_NETLINK_DIAG=y
CONFIG_CGROUP_NET_PRIO=y
CONFIG_BT=m
CONFIG_BT_RFCOMM=m
CONFIG_BT_RFCOMM_TTY=y
CONFIG_BT_BNEP=m
CONFIG_BT_HIDP=m
CONFIG_CFG80211=m
CONFIG_RFKILL=y
CONFIG_FAILOVER=y
CONFIG_DEVTMPFS=y
CONFIG_DEVTMPFS_MOUNT=y
CONFIG_BLK_DEV_LOOP=y
CONFIG_NANOKVM_EFUSE=y
CONFIG_NANOKVM_HDMI_RESET=y
CONFIG_SCSI=y
CONFIG_BLK_DEV_SD=y
CONFIG_BLK_DEV_SR=y
CONFIG_NETDEVICES=y
CONFIG_DUMMY=m
CONFIG_MACVLAN=m
CONFIG_IPVLAN=m
CONFIG_VXLAN=m
CONFIG_TUN=y
CONFIG_OVPN=m
CONFIG_VETH=m
CONFIG_STMMAC_ETH=y
CONFIG_DWMAC_SOPHGO=y
CONFIG_MDIO_BUS_MUX_MMIOREG=y
CONFIG_NANOKVM_CVITEK_PHY=y
CONFIG_REALTEK_PHY=y
CONFIG_INPUT_MOUSEDEV=y
CONFIG_INPUT_EVDEV=y
CONFIG_KEYBOARD_GPIO=y
CONFIG_SERIAL_8250=y
CONFIG_SERIAL_8250_CONSOLE=y
CONFIG_SERIAL_8250_DW=y
CONFIG_SERIAL_OF_PLATFORM=y
CONFIG_SERIAL_EARLYCON_RISCV_SBI=y
CONFIG_HW_RANDOM=y
CONFIG_I2C_CHARDEV=y
CONFIG_I2C_DESIGNWARE_CORE=y
CONFIG_I2C_GPIO=y
CONFIG_SPI=y
CONFIG_SPI_MEM=y
# CONFIG_PTP_1588_CLOCK is not set
CONFIG_PINCTRL=y
CONFIG_PINCTRL_SOPHGO_SG2002=y
CONFIG_GPIOLIB=y
CONFIG_GPIO_DWAPB=y
CONFIG_POWER_RESET=y
CONFIG_POWER_RESET_GPIO_RESTART=y
CONFIG_POWER_RESET_SYSCON=y
CONFIG_POWER_RESET_SYSCON_POWEROFF=y
CONFIG_POWER_SEQUENCING=y
CONFIG_POWER_SUPPLY=y
CONFIG_THERMAL=y
CONFIG_CPU_THERMAL=y
CONFIG_DEVFREQ_THERMAL=y
CONFIG_WATCHDOG=y
CONFIG_DW_WATCHDOG=y
CONFIG_REGULATOR=y
CONFIG_REGULATOR_FIXED_VOLTAGE=y
CONFIG_REGULATOR_GPIO=y
CONFIG_MEDIA_SUPPORT=y
CONFIG_MEDIA_PLATFORM_SUPPORT=y
CONFIG_FB=y
CONFIG_BACKLIGHT_CLASS_DEVICE=m
CONFIG_FRAMEBUFFER_CONSOLE=y
CONFIG_FRAMEBUFFER_CONSOLE_DETECT_PRIMARY=y
CONFIG_SOUND=y
CONFIG_SND=y
CONFIG_SND_SOC=y
CONFIG_SND_DESIGNWARE_I2S=m
CONFIG_SND_SOC_SPDIF=m
CONFIG_SND_SIMPLE_CARD=m
CONFIG_USB=y
CONFIG_USB_OTG=y
CONFIG_USB_STORAGE=y
CONFIG_USB_UAS=y
CONFIG_USB_DWC2=y
CONFIG_USB_GADGET=y
CONFIG_USB_CONFIGFS=y
CONFIG_USB_CONFIGFS_SERIAL=y
CONFIG_USB_CONFIGFS_ACM=y
CONFIG_USB_CONFIGFS_OBEX=y
CONFIG_USB_CONFIGFS_NCM=y
CONFIG_USB_CONFIGFS_ECM=y
CONFIG_USB_CONFIGFS_ECM_SUBSET=y
CONFIG_USB_CONFIGFS_RNDIS=y
CONFIG_USB_CONFIGFS_EEM=y
CONFIG_USB_CONFIGFS_MASS_STORAGE=y
CONFIG_USB_CONFIGFS_F_FS=y
CONFIG_USB_CONFIGFS_F_HID=y
CONFIG_MMC=y
CONFIG_MMC_SDHCI=y
CONFIG_MMC_SDHCI_PLTFM=y
CONFIG_MMC_SDHCI_OF_DWCMSHC=y
CONFIG_NEW_LEDS=y
CONFIG_LEDS_CLASS=y
CONFIG_LEDS_GPIO=y
CONFIG_LEDS_TRIGGERS=y
CONFIG_LEDS_TRIGGER_ACTIVITY=y
CONFIG_RTC_CLASS=y
CONFIG_RTC_DRV_CV1800=y
CONFIG_DMADEVICES=y
CONFIG_DW_AXI_DMAC=y
CONFIG_SYNC_FILE=y
CONFIG_DMABUF_HEAPS=y
# The qualified board DT supplies the dedicated 64 MiB reusable ION pool.
CONFIG_CMA=y
CONFIG_DMA_CMA=y
CONFIG_CMA_SYSFS=y
CONFIG_CMA_DEBUGFS=y
CONFIG_CMA_SIZE_MBYTES=0
# CONFIG_ION_CMA_HEAP is not set
CONFIG_UIO=y
CONFIG_UIO_PDRV_GENIRQ=y
# CONFIG_VIRTIO_MENU is not set
CONFIG_STAGING=y
CONFIG_ION=y
CONFIG_ION_CARVEOUT_HEAP=y
CONFIG_ION_CVITEK=y
CONFIG_CLK_SOPHGO_CV1800=y
CONFIG_MAILBOX=y
CONFIG_SOPHGO_CV1800_RTCSYS=y
CONFIG_PM_DEVFREQ=y
CONFIG_EXTCON=y
CONFIG_IIO=y
CONFIG_PWM=y
CONFIG_PHY_SOPHGO_CV1800_USB2=y
CONFIG_EXT4_FS=y
CONFIG_EXT4_FS_POSIX_ACL=y
CONFIG_EXT4_FS_SECURITY=y
CONFIG_AUTOFS_FS=y
CONFIG_OVERLAY_FS=m
CONFIG_ISO9660_FS=y
CONFIG_JOLIET=y
CONFIG_ZISOFS=y
CONFIG_MSDOS_FS=y
CONFIG_VFAT_FS=y
CONFIG_EXFAT_FS=y
CONFIG_PROC_CHILDREN=y
CONFIG_TMPFS=y
CONFIG_TMPFS_POSIX_ACL=y
CONFIG_NLS_CODEPAGE_437=y
CONFIG_NLS_ISO8859_1=y
CONFIG_SECURITY=y
CONFIG_SECURITYFS=y
CONFIG_SECURITY_NETWORK=y
CONFIG_SECURITY_PATH=y
CONFIG_CRYPTO_USER_API_HASH=m
CONFIG_CRYPTO_KRB5=m
CONFIG_PRINTK_TIME=y
CONFIG_DEBUG_KERNEL=y
CONFIG_DEBUG_FS=y
CONFIG_RCU_TRACE=y
# CONFIG_RUNTIME_TESTING_MENU is not set
# User-selected memory budget: disable strict kernel section permissions.
# CONFIG_STRICT_KERNEL_RWX is not set

CONFIG_ZRAM=m
CONFIG_ZRAM_BACKEND_LZ4=y
CONFIG_ZRAM_DEF_COMP_LZ4=y
CONFIG_ZRAM_MULTI_COMP=y
CONFIG_ZRAM_BACKEND_ZSTD=y
CONFIG_ZRAM_TRACK_ENTRY_ACTIME=y
CONFIG_LRU_GEN=y
CONFIG_LRU_GEN_ENABLED=y
# CONFIG_LRU_GEN_STATS is not set
```
