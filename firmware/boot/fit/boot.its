## platform/boot/boot.its
```
/dts-v1/;
/ {
    // One description for every board: images differ only in the device tree.
    description = "NanoKVM OS";
    #address-cells = <1>;
    images {
        kernel-1 {
            description = "NanoKVM OS Linux";
            data = /incbin/("Image.lz4");
            type = "kernel";
            arch = "riscv";
            os = "linux";
            compression = "lz4";
            load = <0x80200000>;
            entry = <0x80200000>;
            // U-Boot checks this on every boot. sha256 runs at about 14.5 MB/s
            // there, 0.6 s for the kernel and initramfs; crc32 detects the
            // same read errors. The device tree keeps sha256, which
            // compose-fit substitutes per board.
            hash-1 { algo = "crc32"; };
        };
        ramdisk-1 {
            description = "NanoKVM OS initramfs";
            data = /incbin/("initramfs.cpio.zst");
            type = "ramdisk";
            arch = "riscv";
            os = "linux";
            // Linux unpacks the zstd cpio; U-Boot passes these bytes unchanged.
            compression = "none";
            hash-1 { algo = "crc32"; };
        };
        fdt-sg2002_licheervnano_sd_minimal {
            description = "NanoKVM OS SG2002 board";
            data = /incbin/("board.dtb");
            type = "flat_dt";
            arch = "riscv";
            compression = "none";
            hash-1 { algo = "sha256"; };
        };
    };
    configurations {
        default = "config-sg2002_licheervnano_sd_minimal";
        config-sg2002_licheervnano_sd_minimal {
            description = "NanoKVM OS with installed loader selection";
            kernel = "kernel-1";
            ramdisk = "ramdisk-1";
            fdt = "fdt-sg2002_licheervnano_sd_minimal";
        };
    };
};
```

## platform/opensbi/defconfig
```kconfig
# SPDX-License-Identifier: BSD-2-Clause
CONFIG_PLATFORM_THEAD=y
CONFIG_FDT_IPI=y
CONFIG_FDT_IPI_MSWI=y
CONFIG_FDT_IRQCHIP=y
CONFIG_FDT_IRQCHIP_PLIC=y
CONFIG_FDT_SERIAL=y
CONFIG_FDT_SERIAL_UART8250=y
CONFIG_FDT_TIMER=y
CONFIG_FDT_TIMER_MTIMER=y
# Unsupported platform facilities are not exposed as working extensions.
# CONFIG_SBI_ECALL_SUSP is not set
# CONFIG_SBI_ECALL_CPPC is not set
# CONFIG_SBI_ECALL_DBTR is not set
# CONFIG_SBI_ECALL_SSE is not set
# CONFIG_SBI_ECALL_MPXY is not set
```

## platform/uboot/defconfig
```kconfig
CONFIG_RISCV=y
CONFIG_CC_OPTIMIZE_FOR_SPEED=y
CONFIG_SYS_MALLOC_LEN=0x820000
CONFIG_SYS_MALLOC_F_LEN=0x8000
CONFIG_NR_DRAM_BANKS=1
CONFIG_HAS_CUSTOM_SYS_INIT_SP_ADDR=y
CONFIG_CUSTOM_SYS_INIT_SP_ADDR=0x82300000
CONFIG_DEFAULT_DEVICE_TREE="sg2002-licheerv-nano-b"
CONFIG_SYS_LOAD_ADDR=0x80080000
CONFIG_IDENT_STRING=" NanoKVM OS"
CONFIG_TARGET_LICHEERV_NANO=y
CONFIG_ARCH_RV64I=y
CONFIG_RISCV_SMODE=y
# CONFIG_RISCV_ISA_F is not set
# CONFIG_RISCV_ISA_D is not set
CONFIG_FIT=y
# CONFIG_FIT_PRINT is not set
# CONFIG_BOOTSTD is not set
# CONFIG_EFI_LOADER is not set
CONFIG_SD_BOOT=y
CONFIG_USE_BOOTCOMMAND=y
CONFIG_BOOTCOMMAND="setenv bootargs root=/dev/mmcblk0p2 rootwait rw console=ttyS0,115200 earlycon=sbi riscv.fwsz=0x80000 release loglevel=0 mitigations=off ${extraargs}; setenv fdt_high 0x8cffffff; setenv initrd_high 0x8cffffff; for image in boot.sd boot.prev; do if fatload mmc 0:1 0x85000000 ${image}; then bootm 0x85000000#config-sg2002_licheervnano_sd_minimal; fi; done; reset"
CONFIG_USE_PREBOOT=y
CONFIG_PREBOOT="if fatload mmc 0:1 0x85000000 uEnv.txt; then env import -t -r 0x85000000 ${filesize} bootdelay extraargs; fi"
CONFIG_HUSH_PARSER=y
CONFIG_SYS_CBSIZE=512
CONFIG_SYS_PBSIZE=544
CONFIG_BOARD_INIT=y
CONFIG_SYS_PROMPT="nanokvm# "
# CONFIG_CMD_BOOTDEV is not set
# CONFIG_CMD_BDI is not set
# CONFIG_CMD_CPU is not set
# CONFIG_CMD_IMI is not set
# CONFIG_CMD_XIMG is not set
# CONFIG_CMD_EXPORTENV is not set
# CONFIG_CMD_EDITENV is not set
# CONFIG_CMD_SAVEENV is not set
# CONFIG_CMD_RANDOM is not set
# CONFIG_CMD_LZMADEC is not set
# CONFIG_CMD_UNLZ4 is not set
# CONFIG_CMD_UNZIP is not set
# CONFIG_CMD_LOADB is not set
# CONFIG_CMD_LOADS is not set
# CONFIG_CMD_ITEST is not set
# CONFIG_CMD_BLOCK_CACHE is not set
CONFIG_CMD_MBR=y
CONFIG_CMD_FAT=y
CONFIG_CMD_MMC=y
CONFIG_CMD_POWEROFF=y
# CONFIG_CMD_MII is not set
# CONFIG_CMD_SYSBOOT is not set
# CONFIG_CMD_ELF is not set
# CONFIG_CMD_SF is not set
# CONFIG_ISO_PARTITION is not set
# CONFIG_EFI_PARTITION is not set
CONFIG_ENV_OVERWRITE=y
CONFIG_FAT_WRITE=y
# CONFIG_NET is not set
CONFIG_CLK_SOPHGO_CV1800B=y
CONFIG_MMC=y
CONFIG_MMC_IO_VOLTAGE=y
CONFIG_MMC_UHS_SUPPORT=y
CONFIG_MMC_SDHCI=y
CONFIG_MMC_SDHCI_ADMA=y
CONFIG_MMC_SDHCI_CV1800B=y
CONFIG_SYS_NS16550=y
CONFIG_SYS_NS16550_MEM32=y
CONFIG_SYSRESET=y
CONFIG_SYSRESET_CV1800B=y
CONFIG_BOOTDELAY=-2
# boot.sd carries an LZ4 kernel (since v3.3.0); no other decompressor is used.
CONFIG_LZ4=y
# CONFIG_GZIP is not set
# CONFIG_MMC_TRACE is not set
# CONFIG_TOOLS_MKEFICAPSULE is not set
```
